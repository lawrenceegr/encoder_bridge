## boards/others/encoder_bridge/board.yml
```yaml
board:
  name: encoder_bridge
  full_name: Encoder Bridge Board
  vendor: others
  socs:
    - name: stm32f030x6
```

## build/Kconfig/Kconfig.shield
```kconfig
osource "/home/marcus/keyboards-firmware/encoder_bridge/boards/shields/*/Kconfig.shield"
```

## build/Kconfig/Kconfig.shield.defconfig
```kconfig
osource "/home/marcus/keyboards-firmware/encoder_bridge/boards/shields/*/Kconfig.defconfig"
```

## build/Kconfig/boards/Kconfig
```kconfig
# Load Zephyr board Kconfig descriptions.
osource "/home/marcus/keyboards-firmware/encoder_bridge/boards/others/encoder_bridge/Kconfig"
```

## build/Kconfig/boards/Kconfig.defconfig
```kconfig
# Load Zephyr board defconfig descriptions.
osource "/home/marcus/keyboards-firmware/encoder_bridge/boards/others/encoder_bridge/Kconfig.defconfig"
```

## build/Kconfig/boards/Kconfig.encoder_bridge
```kconfig
# Load board Kconfig descriptions.
osource "/home/marcus/keyboards-firmware/encoder_bridge/boards/others/encoder_bridge/Kconfig.encoder_bridge"
```

## build/Kconfig/boards/Kconfig.sysbuild
```kconfig
# Load Sysbuild board Kconfig descriptions.
osource "/home/marcus/keyboards-firmware/encoder_bridge/boards/others/encoder_bridge/Kconfig.sysbuild"
```
